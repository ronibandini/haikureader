// Haiku eInk Reader
// Roni Bandini, Instagram @RoniBandini 
// More electronic art projects at bandini.medium.com        
// Buenos Aires, Argentina, 2021
// ESP32 to 2.9 eInk connections: Busy D4, RST D21, DC D22, CS D5, CLK D18, DIN D23, 

#include <GxEPD.h>
#include <GxGDEH029A1/GxGDEH029A1.h>
#include <GxIO/GxIO_SPI/GxIO_SPI.h>
#include <GxIO/GxIO.h>

// eInk pins
GxIO_Class io(SPI, 5, 22, 21, 4); 
GxEPD_Class display(io, 21, 4); 

// D12 and D13 buttons
int buttonPin1=12;
int buttonPin2=13;

// counter
int counter=0;

// Open screen
const unsigned char myBitmap [] PROGMEM = {
  0xff, 0xff, 0xff, 0xff, 0xff, 0xff, 0xff, 0xff, 0xff, 0xff, 0xff, 0xff, 0xff, 0xff, 0xff, 0xff, 
  0xff, 0xff, 0xff, 0xff, 0xff, 0xff, 0xff, 0xff, 0xff, 0xff, 0xff, 0xff, 0xff, 0xff, 0xff, 0xff, 
  0xff, 0xff, 0xff, 0xff, 0xff, 0xff, 0xff, 0xff, 0xff, 0xff, 0xff, 0xff, 0xff, 0xff, 0xff, 0xff, 
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  0xff, 0xff, 0xff, 0xff, 0xff, 0xff, 0xff, 0xff, 0xff, 0xff, 0xff, 0xff, 0xff, 0xff, 0xff, 0xff
};



void setup() {

  pinMode(buttonPin1, INPUT_PULLUP);  
  pinMode(buttonPin2, INPUT_PULLUP);  
    
  display.init();

  display.setTextColor(GxEPD_BLACK);     
  
}

void loop() 
{

 int buttonReading1 = digitalRead(buttonPin1);
 int buttonReading2 = digitalRead(buttonPin2);


  if (buttonReading1==0){    
    counter=counter-1;      
    if (counter<0) {counter=0;}
     updateHaiku(); 
  }

  if (buttonReading2==0){
    counter=counter+1;    
    if (counter>4) {counter=4;}
     updateHaiku();
  }
  
  delay(50);
     
  
}

void updateHaiku() {

   display.fillScreen(GxEPD_WHITE); 

   if (counter==0){
      display.fillScreen(GxEPD_BLACK);
      display.drawBitmap(0, 0, myBitmap, 128, 296, GxEPD_WHITE);
      display.update();  
    }
    
   if (counter==1){    
    
    display.setCursor(1, 1);
    display.setTextSize(0);
    display.println("Matsuo Basho");
    display.println("(1644-1694)");
    display.println("");
    display.println("An old silent pond...");
    display.println("A frog jumps into the pond,");
    display.println("splash, silence again");
    display.println("");
    display.println("Autumn moonlight");
    display.println("a worm digs silently");
    display.println("into the chestnut.");
    display.println("");
    display.println("In the twilight rain");
    display.println("these brilliant-hued hibiscus -");
    display.println("A lovely sunset.");
    
    display.update();
      
  
  }

    if (counter==2){
      
     display.setCursor(1, 1);
     display.setTextSize(0);
     display.println("Yosa Buson");
     display.println("(1716-1784)");
     display.println("");              

     display.println("A summer river being crossed");
     display.println("how pleasing");
     display.println("with sandals in my    hands!");
     display.println("");
     display.println("Light of the moon");
     display.println("Moves west, flowers' shadows");
     display.println("Creep eastward.");
     display.println("");
     display.println("In the moonlight,");
     display.println("The color and scent   of the wisteria");
     display.println("Seems far away.");

     display.update();
      
  
  }

    if (counter==3){
      
    display.setCursor(1, 1); 
    display.setTextSize(0);     
    display.println("Masaoka Shiki ");
    display.println("(1867-1902)");
    display.println("");               

    display.println("I want to sleep");
    display.println("Swat the flies");
    display.println("Softly, please.");
    display.println("");
    display.println("After killing");
    display.println("a spider, how lonely I feel");
    display.println("in the cold of night!");
    display.println("");
    display.println("For love and for hate");
    display.println("I swat a fly and      offer it");
    display.println("to an ant.");
    
    display.update();
      
  
  }

     if (counter==4){
      
    display.setCursor(1, 1); 
    display.setTextSize(0);     
    display.println("Natsume Soseki ");
    display.println("(1867-1916)");
    display.println("");               

    display.println("The lamp once out");
    display.println("Cool stars enter");
    display.println("The window frame.");
    display.println("");
    display.println("Plum flower temple:");
    display.println("Voices rise");
    display.println("From the foothills");
    display.println("");
    display.println("The crow has flown   away:");
    display.println("swaying in the        evening sun,");
    display.println("a leafless tree.");
       
    display.update();
      
  
  }

  
  }
